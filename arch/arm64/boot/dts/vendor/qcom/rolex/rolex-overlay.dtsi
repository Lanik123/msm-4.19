#include "rolex-general.dtsi"
#include "rolex-pinctrl.dtsi"
//#include "rolex-audio.dtsi"
#include "rolex-memory.dtsi"
//#include "rolex-camera-qrd.dtsi"
#include "rolex-panel.dtsi" 
#include "rolex-regulator.dtsi" 