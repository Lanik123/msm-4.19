/*
 * Copyright (c) 2016, The Linux Foundation. All rights reserved.
 *
 * This program is free software; you can redistribute it and/or modify
 * it under the terms of the GNU General Public License version 2 and
 * only version 2 as published by the Free Software Foundation.
 *
 * This program is distributed in the hope that it will be useful,
 * but WITHOUT ANY WARRANTY; without even the implied warranty of
 * MERCHANTABILITY or FITNESS FOR A PARTICULAR PURPOSE.  See the
 * GNU General Public License for more details.
 */
 
/dts-v1/;

#include "msm8917.dtsi"
#include "msm8917-qrd.dtsi"
#include "msm8937-mdss-panels.dtsi"

/ {
	model = "Qualcomm Technologies, Inc. MSM8917-PMI8937 QRD SKU5";
	compatible = "qcom,msm8917-qrd-sku5", "qcom,msm8917-qrd",
		   "qcom,msm8917", "qcom,qrd";
	qcom,board-id= <0x1000b 1>, <0x2000b 1>;
};

/* msm8917-pmi8937-qrd-sku5 */
/ {
	qrd_batterydata: qcom,battery-data {
		qcom,batt-id-range-pct = <15>;
		qcom,rpull-up-kohm = <68>;
		qcom,vref-batt-therm = <1800000>;
		#include "rolex/battery/batterydata-wingtech-feimaotui_SONY-4v4-3030mah.dtsi"
		#include "rolex/battery/batterydata-wingtech-xingwangda_ATL-4v4-3030mah.dtsi"
	};
};

#include "rolex/rolex-overlay.dtsi"
