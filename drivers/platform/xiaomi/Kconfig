## drivers/platform/xiaomi/Kconfig
```kconfig
# Xiaomi configuration options

config MACH_XIAOMI_MSM8917
	bool "Xiaomi MSM8917"
	depends on ARCH_MSM8917
	help
	  Support for MSM8917 Xiaomi variants

menu "Xiaomi board selection"

config MACH_XIAOMI_ROLEX
	bool "Rolex board"
	select MACH_XIAOMI_MSM8917
	help
	  Support for Redmi 4A

endmenu
```
